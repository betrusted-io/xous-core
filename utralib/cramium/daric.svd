# daric register map
Vendor: cramium
Registers are 32-bit, read-write, reset 0x0 unless marked. A register's access mark holds for its fields unless they carry their own. Offsets are from the block's base; [hi:lo] are bit positions; {n}, {i} and the like mark numbered series.

## DUART
Base 0x40042000
0x00 SFR_TXD — See file:///F:/code/cram-nto/modules/core/rtl/duart.sv
  [7:0] sfr_txd — sfr_txd read/write control register
0x04 SFR_CR — See file:///F:/code/cram-nto/modules/core/rtl/duart.sv
  [0] sfr_cr — sfr_cr read/write control register
0x08 SFR_SR — See file:///F:/code/cram-nto/modules/core/rtl/duart.sv
  [0] sfr_sr — sfr_sr read only status register
0x0C SFR_ETUC — See file:///F:/code/cram-nto/modules/core/rtl/duart.sv
  [15:0] sfr_etuc — sfr_etuc read/write control register

## RBIST_WRP
Base 0x40045000
0x00 SFRCR_TRM — See file:///F:/code/cram-nto/modules/rbist/rtl/rbist_wrp.sv
  [23:0] sfrcr_trm — sfrcr_trm read/write control register
0x04 SFRSR_TRM — See file:///F:/code/cram-nto/modules/rbist/rtl/rbist_wrp.sv
  [23:0] sfrsr_trm — sfrsr_trm read only status register
0x08 SFRAR_TRM — See file:///F:/code/cram-nto/modules/rbist/rtl/rbist_wrp.sv
  [31:0] sfrar_trm — sfrar_trm performs action on write of value: 0x5a

## EVC
Base 0x40044000
{0x0+4i} SFR_CM7EVSEL_CM7EVSEL{i} (i=0..7) — See file:///F:/code/cram-nto/modules/sysctrl/rtl/evc.sv
  [7:0] cm7evsel{i} — cm7evsel read/write control register
0x20 SFR_CM7EVEN — See file:///F:/code/cram-nto/modules/sysctrl/rtl/evc.sv
  [7:0] cm7even — cm7even read/write control register
0x24 SFR_CM7EVFR — See file:///F:/code/cram-nto/modules/sysctrl/rtl/evc.sv
  [7:0] cm7evs — cm7evs flag register. `1` means event happened, write back `1` in respective bit position to clear the flag
0x30 SFR_TMREVSEL — See file:///F:/code/cram-nto/modules/sysctrl/rtl/evc.sv
  [15:0] tmr_evsel — tmr_evsel read/write control register
0x34 SFR_TMREVEN — See file:///F:/code/cram-nto/modules/sysctrl/rtl/evc.sv
  [1:0] sfr_tmreven — sfr_tmreven read/write control register
{0x40+4i} SFR_IFEVEN_IFEVEN{i} (i=0..7) — See file:///F:/code/cram-nto/modules/sysctrl/rtl/evc.sv
  [31:0] ifeven{i} — ifeven read/write control register
0x60 SFR_IFEVERRFR — See file:///F:/code/cram-nto/modules/sysctrl/rtl/evc.sv
  [31:0] ifev_errs — ifev_errs flag register. `1` means event happened, write back `1` in respective bit position to clear the flag
0x80 SFR_CM7ERRFR — See file:///F:/code/cram-nto/modules/sysctrl/rtl/evc.sv
  [31:0] errin — errin flag register. `1` means event happened, write back `1` in respective bit position to clear the flag
0x84 SFR_CM7ERRCR — See file:///F:/code/cram-nto/modules/sysctrl/rtl/evc.sv
  [31:0] erren — erren read/write control register
{0x90+4i} SFR_RRCEVSEL_RRC_EVSEL{i} (i=0..3) — See file:///F:/code/cram-nto/modules/sysctrl/rtl/evc.sv
  [31:0] rrc_evsel{i} — rrc_evsel read/write control register
0xA0 SFR_RRCEVEN — See file:///F:/code/cram-nto/modules/sysctrl/rtl/evc.sv
  [15:0] rrc_even — rrc_even read/write control register

## IOX
Base 0x5012F000
{0x0+4i} SFR_AFSEL_CRAFSEL{i} (i=0..11) — See file:///F:/code/cram-nto/modules/ifsub/rtl/iox.sv
  [15:0] crafsel{i} — crafsel read/write control register
{0x100+4i} SFR_INTCR_CRINT{i} (i=0..7) — See file:///F:/code/cram-nto/modules/ifsub/rtl/iox.sv
  [9:0] crint{i} — crint read/write control register
0x120 SFR_INTFR — See file:///F:/code/cram-nto/modules/ifsub/rtl/iox.sv
  [7:0] frint — frint flag register. `1` means event happened, write back `1` in respective bit position to clear the flag
{0x130+4i} SFR_GPIOOUT_CRGO{i} (i=0..5) — See file:///F:/code/cram-nto/modules/ifsub/rtl/iox.sv
  [15:0] crgo{i} — crgo read/write control register
{0x148+4i} SFR_GPIOOE_CRGOE{i} (i=0..5) — See file:///F:/code/cram-nto/modules/ifsub/rtl/iox.sv
  [15:0] crgoe{i} — crgoe read/write control register
{0x160+4i} SFR_GPIOPU_CRGPU{i} (i=0..5) — See file:///F:/code/cram-nto/modules/ifsub/rtl/iox.sv
  [15:0] crgpu{i} — crgpu read/write control register
{0x178+4i} SFR_GPIOIN_SRGI{i} (i=0..5) — See file:///F:/code/cram-nto/modules/ifsub/rtl/iox.sv
  [15:0] srgi{i} — srgi read only status register
0x200 SFR_PIOSEL — See file:///F:/code/cram-nto/modules/ifsub/rtl/iox.sv
  [31:0] piosel — piosel read/write control register
{0x230+4i} SFR_CFG_SCHM_CR_CFG_SCHMSEL{i} (i=0..5) — See file:///F:/code/cram-nto/modules/ifsub/rtl/iox.sv
  [15:0] cr_cfg_schmsel{i} — cr_cfg_schmsel read/write control register
{0x248+4i} SFR_CFG_SLEW_CR_CFG_SLEWSLOW{i} (i=0..5) — See file:///F:/code/cram-nto/modules/ifsub/rtl/iox.sv
  [15:0] cr_cfg_slewslow{i} — cr_cfg_slewslow read/write control register
{0x260+4i} SFR_CFG_DRVSEL_CR_CFG_DRVSEL{i} (i=0..5) — See file:///F:/code/cram-nto/modules/ifsub/rtl/iox.sv
  [31:0] cr_cfg_drvsel{i} — cr_cfg_drvsel read/write control register
