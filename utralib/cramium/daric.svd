# daric register map
Vendor: cramium
Registers are 32-bit, read-write, reset 0x0 unless marked. A register's access mark holds for its fields unless they carry their own. Offsets are from the block's base; [hi:lo] are bit positions; {n}, {i} and the like mark numbered series.

## SYSCTRL
Base 0x40040000
0x00 SFR_CGUSEC — See file:///F:/code/cram-nto/modules/sysctrl/rtl/sysctrl.sv
  [15:0] sfr_cgusec — sfr_cgusec read/write control register
0x04 SFR_CGULP — See file:///F:/code/cram-nto/modules/sysctrl/rtl/sysctrl.sv
  [15:0] sfr_cgulp — sfr_cgulp read/write control register
0x08 SFR_SEED — See file:///F:/code/cram-nto/modules/sysctrl/rtl/sysctrl.sv
  [31:0] sfr_seed — sfr_seed read/write control register
0x0C SFR_SEEDAR — See file:///F:/code/cram-nto/modules/sysctrl/rtl/sysctrl.sv
  [31:0] sfr_seedar — sfr_seedar performs action on write of value: 0x5a
0x10 SFR_CGUSEL0 — See file:///F:/code/cram-nto/modules/sysctrl/rtl/sysctrl.sv
  [1:0] sfr_cgusel0 — sfr_cgusel0 read/write control register
{0x14+4i} SFR_CGUFD_CFGFDCR_0_4_{i} (i=0..4) — See file:///F:/code/cram-nto/modules/sysctrl/rtl/sysctrl.sv
  [31:0] cfgfdcr_0_4_{i} — cfgfdcr read/write control register
0x28 SFR_CGUFDAO — See file:///F:/code/cram-nto/modules/sysctrl/rtl/sysctrl.sv
  [31:0] cfgfdcr — cfgfdcr read/write control register
0x2C SFR_CGUSET — See file:///F:/code/cram-nto/modules/sysctrl/rtl/sysctrl.sv
  [31:0] sfr_cguset — sfr_cguset performs action on write of value: 0x32
0x30 SFR_CGUSEL1 — See file:///F:/code/cram-nto/modules/sysctrl/rtl/sysctrl.sv
  [0] sfr_cgusel1 — sfr_cgusel1 read/write control register
0x34 SFR_CGUFDPKE — See file:///F:/code/cram-nto/modules/sysctrl/rtl/sysctrl.sv
  [7:0] sfr_cgufdpke — sfr_cgufdpke read/write control register
0x38 SFR_CGUFDAORAM — See file:///F:/code/cram-nto/modules/sysctrl/rtl/sysctrl.sv
  [15:0] sfr_cgufdaoram — sfr_cgufdaoram read/write control register
0x3C SFR_CGUFDPER — See file:///F:/code/cram-nto/modules/sysctrl/rtl/sysctrl.sv
  [31:0] sfr_cgufdper — sfr_cgufdper read/write control register
{0x40+4i} SFR_CGUFSSR_FSFREQ{i} (i=0..3) — See file:///F:/code/cram-nto/modules/sysctrl/rtl/sysctrl.sv
  [31:0] fsfreq{i} — fsfreq read only status register
0x50 SFR_CGUFSVLD — See file:///F:/code/cram-nto/modules/sysctrl/rtl/sysctrl.sv
  [7:0] sfr_cgufsvld — sfr_cgufsvld read only status register
0x54 SFR_CGUFSCR — See file:///F:/code/cram-nto/modules/sysctrl/rtl/sysctrl.sv
  [15:0] sfr_cgufscr — sfr_cgufscr read/write control register
0x60 SFR_ACLKGR — See file:///F:/code/cram-nto/modules/sysctrl/rtl/sysctrl.sv
  [7:0] aclksubgate — aclksubgate read only status register
0x64 SFR_HCLKGR — See file:///F:/code/cram-nto/modules/sysctrl/rtl/sysctrl.sv
  [7:0] hclksubgate — hclksubgate read only status register
0x68 SFR_ICLKGR — See file:///F:/code/cram-nto/modules/sysctrl/rtl/sysctrl.sv
  [7:0] iclksubgate — iclksubgate read only status register
0x6C SFR_PCLKGR — See file:///F:/code/cram-nto/modules/sysctrl/rtl/sysctrl.sv
  [7:0] pclksubgate — pclksubgate read only status register
0x80 SFR_RCURST0 — See file:///F:/code/cram-nto/modules/sysctrl/rtl/sysctrl.sv
  [31:0] sfr_rcurst0 — sfr_rcurst0 performs action on write of value: 0x55aa
0x84 SFR_RCURST1 — See file:///F:/code/cram-nto/modules/sysctrl/rtl/sysctrl.sv
  [31:0] sfr_rcurst1 — sfr_rcurst1 performs action on write of value: 0x55aa
0x88 SFR_RCUSRCFR — See file:///F:/code/cram-nto/modules/sysctrl/rtl/sysctrl.sv
  [15:0] sfr_rcusrcfr — sfr_rcusrcfr flag register. `1` means event happened, write back `1` in respective bit position to clear the flag
0x90 SFR_IPCARIPFLOW — See file:///F:/code/cram-nto/modules/sysctrl/rtl/sysctrl.sv
  [31:0] sfr_ipcaripflow — sfr_ipcaripflow performs action on write of value: 0x57
0x94 SFR_IPCEN — See file:///F:/code/cram-nto/modules/sysctrl/rtl/sysctrl.sv
  [15:0] sfr_ipcen — sfr_ipcen read/write control register
0x98 SFR_IPCLPEN — See file:///F:/code/cram-nto/modules/sysctrl/rtl/sysctrl.sv
  [15:0] sfr_ipclpen — sfr_ipclpen read/write control register
0x9C SFR_IPCOSC — See file:///F:/code/cram-nto/modules/sysctrl/rtl/sysctrl.sv
  [6:0] sfr_ipcosc — sfr_ipcosc read/write control register
0xA0 SFR_IPCPLLMN — See file:///F:/code/cram-nto/modules/sysctrl/rtl/sysctrl.sv
  [16:0] sfr_ipcpllmn — sfr_ipcpllmn read/write control register
0xA4 SFR_IPCPLLF — See file:///F:/code/cram-nto/modules/sysctrl/rtl/sysctrl.sv
  [24:0] sfr_ipcpllf — sfr_ipcpllf read/write control register
0xA8 SFR_IPCPLLQ — See file:///F:/code/cram-nto/modules/sysctrl/rtl/sysctrl.sv
  [14:0] sfr_ipcpllq — sfr_ipcpllq read/write control register
0xAC SFR_IPCCR — See file:///F:/code/cram-nto/modules/sysctrl/rtl/sysctrl.sv
  [15:0] sfr_ipccr — sfr_ipccr read/write control register
