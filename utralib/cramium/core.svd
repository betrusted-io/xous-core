# core register map
Vendor: litex
Litex SoC 2025-02-08 04:21:32
Registers are 32-bit, read-write, reset 0x0 unless marked. A register's access mark holds for its fields unless they carry their own. Offsets are from the block's base; lines under a group give offsets from that group; [hi:lo] are bit positions; {n}, {i} and the like mark numbered series; 'fields as' and 'values as' point back to an identical list; <NAME> marks a mode.

## Memory map
0xE0000000 D11CTIME size 0x8
0xE0001000 SUSRES size 0x2C
0xE0002000 COREUSER size 0x18
0xE0003000 CSRTEST size 0x8
0xE0004000 IRQARRAY0 size 0x18
0xE0005000 IRQARRAY1 size 0x18
{0xDFFFC000+0x1000*n} IRQARRAY{n} size 0x18 (n=10..19)
{0xE000E000+0x1000*n} IRQARRAY{n} size 0x18 (n=2..9)
0xE0018000 MAILBOX size 0x24
0xE0019000 MB_CLIENT size 0x20
0xE001A000 RESETVALUE size 0x4
0xE001B000 TICKTIMER size 0x24
0xE001C000 TIMER0 size 0x20

## Interrupts
{n} irqarray{n} (IRQARRAY{n}) (n=0..19)
20 ticktimer (TICKTIMER)
21 susres (SUSRES)
22 mailbox (MAILBOX)
23 mb_client (MB_CLIENT)
30 timer0 (TIMER0)

## Further device data
memoryRegions:
  CSR baseAddress=0xE0000000 size=0x00040000
constants:
  CONFIG_CLOCK_FREQUENCY value=800000000
  CONFIG_CPU_HAS_INTERRUPT value=None
  CONFIG_CPU_RESET_ADDR value=1610612736
  CONFIG_CPU_HAS_DCACHE value=None
  CONFIG_CPU_HAS_ICACHE value=None
  CONFIG_CPU_TYPE_VEXRISCV_AXI value=None
  CONFIG_CPU_VARIANT_STANDARD value=None
  CONFIG_CPU_HUMAN_NAME value=VexRiscvAxi4
  CONFIG_CPU_NOP value=nop
  IFSUB_EV_QFCIRQ value=32
  IFSUB_EV_MDMAIRQ value=33
  IFSUB_EV_MBOX_IRQ_AVAILABLE value=34
  IFSUB_EV_MBOX_IRQ_ABORT_INIT value=35
  IFSUB_EV_MBOX_IRQ_DONE value=36
  IFSUB_EV_MBOX_IRQ_ERROR value=37
  IFSUB_EV_AOWKUPINT value=47
  IFSUB_EV_TRNG_DONE value=48
  IFSUB_EV_AES_DONE value=49
  IFSUB_EV_PKE_DONE value=50
  IFSUB_EV_HASH_DONE value=51
  IFSUB_EV_ALU_DONE value=52
  IFSUB_EV_SDMA_ICHDONE value=53
  IFSUB_EV_SDMA_SCHDONE value=54
  IFSUB_EV_SDMA_XCHDONE value=55
  IFSUB_EV_UART0_RX value=80
  IFSUB_EV_UART0_TX value=81
  IFSUB_EV_UART0_RX_CHAR value=82
  IFSUB_EV_UART0_ERR value=83
  IFSUB_EV_UART1_RX value=84
  IFSUB_EV_UART1_TX value=85
  IFSUB_EV_UART1_RX_CHAR value=86
  IFSUB_EV_UART1_ERR value=87
  IFSUB_EV_UART2_RX value=88
  IFSUB_EV_UART2_TX value=89
  IFSUB_EV_UART2_RX_CHAR value=90
  IFSUB_EV_UART2_ERR value=91
  IFSUB_EV_UART3_RX value=92
  IFSUB_EV_UART3_TX value=93
  IFSUB_EV_UART3_RX_CHAR value=94
  IFSUB_EV_UART3_ERR value=95
  IFSUB_EV_SPIM0_RX value=96
  IFSUB_EV_SPIM0_TX value=97
  IFSUB_EV_SPIM0_CMD value=98
  IFSUB_EV_SPIM0_EOT value=99
  IFSUB_EV_SPIM1_RX value=100
  IFSUB_EV_SPIM1_TX value=101
  IFSUB_EV_SPIM1_CMD value=102
  IFSUB_EV_SPIM1_EOT value=103
  IFSUB_EV_SPIM2_RX value=104
  IFSUB_EV_SPIM2_TX value=105
  IFSUB_EV_SPIM2_CMD value=106
  IFSUB_EV_SPIM2_EOT value=107
  IFSUB_EV_SPIM3_RX value=108
  IFSUB_EV_SPIM3_TX value=109
  IFSUB_EV_SPIM3_CMD value=110
  IFSUB_EV_SPIM3_EOT value=111
  IFSUB_EV_I2C0_RX value=112
  IFSUB_EV_I2C0_TX value=113
  IFSUB_EV_I2C0_CMD value=114
  IFSUB_EV_I2C0_EOT value=115
  IFSUB_EV_I2C1_RX value=116
  IFSUB_EV_I2C1_TX value=117
  IFSUB_EV_I2C1_CMD value=118
  IFSUB_EV_I2C1_EOT value=119
  IFSUB_EV_I2C2_RX value=120
  IFSUB_EV_I2C2_TX value=121
  IFSUB_EV_I2C2_CMD value=122
  IFSUB_EV_I2C2_EOT value=123
  IFSUB_EV_I2C3_RX value=124
  IFSUB_EV_I2C3_TX value=125
  IFSUB_EV_I2C3_CMD value=126
  IFSUB_EV_I2C3_EOT value=127
  IFSUB_EV_SDIO_RX value=128
  IFSUB_EV_SDIO_TX value=129
  IFSUB_EV_SDIO_EOT value=130
  IFSUB_EV_SDIO_ERR value=131
  IFSUB_EV_I2S_RX value=132
  IFSUB_EV_I2S_TX value=133
  IFSUB_EV_CAM_RX value=136
  IFSUB_EV_ADC_RX value=137
  IFSUB_EV_FILTER_EOT value=140
  IFSUB_EV_FILTER_ACT value=141
  IFSUB_EV_SCIF_RX value=144
  IFSUB_EV_SCIF_TX value=145
  IFSUB_EV_SCIF_RX_CHAR value=146
  IFSUB_EV_SCIF_ERR value=147
  IFSUB_EV_SPIS0_RX value=148
  IFSUB_EV_SPIS0_TX value=149
  IFSUB_EV_SPIS0_EOT value=150
  IFSUB_EV_SPIS1_RX value=152
  IFSUB_EV_SPIS1_TX value=153
  IFSUB_EV_SPIS1_EOT value=154
  IFSUB_EV_PWM0_EV value=156
  IFSUB_EV_PWM1_EV value=157
  IFSUB_EV_PWM2_EV value=158
  IFSUB_EV_PWM3_EV value=159
  IFSUB_EV_IOXIRQ value=160
  IFSUB_EV_USBC value=161
  IFSUB_EV_SDDCIRQ value=162
  IFSUB_EV_PIOIRQ0 value=163
  IFSUB_EV_PIOIRQ1 value=164
  IFSUB_EV_PIOIRQ2 value=165
  IFSUB_EV_PIOIRQ3 value=166
  IFSUB_EV_I2C0_NACK value=200
  IFSUB_EV_I2C1_NACK value=201
  IFSUB_EV_I2C2_NACK value=202
  IFSUB_EV_I2C3_NACK value=203
  IFSUB_EV_I2C0_ERR value=204
  IFSUB_EV_I2C1_ERR value=205
  IFSUB_EV_I2C2_ERR value=206
  IFSUB_EV_I2C3_ERR value=207
  IFSUB_EV_CORESUBERR value=208
  IFSUB_EV_SCEERR value=209
  IFSUB_EV_IFSUBERR value=210
  IFSUB_EV_SECIRQ value=211
  IFSUB_EV_SEC0 value=240
  CONFIG_CSR_DATA_WIDTH value=32
  CONFIG_CSR_ALIGNMENT value=32
  CONFIG_BUS_STANDARD value=AXI-LITE
  CONFIG_BUS_DATA_WIDTH value=32
  CONFIG_BUS_ADDRESS_WIDTH value=32
  CONFIG_BUS_BURSTING value=0
  IRQARRAY{n}_INTERRUPT value={n} (n=0..19)
  MAILBOX_INTERRUPT value=22
  MB_CLIENT_INTERRUPT value=23
  SUSRES_INTERRUPT value=21
  TICKTIMER_INTERRUPT value=20
  TIMER0_INTERRUPT value=30
