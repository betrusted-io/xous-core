# soc-b414f2b register map
Vendor: litex
Litex SoC 2022-11-17 18:56:55
Registers are 32-bit, read-write, reset 0x0 unless marked. A register's access mark holds for its fields unless they carry their own. Offsets are from the block's base; lines under a group give offsets from that group; [hi:lo] are bit positions; {n}, {i} and the like mark numbered series; 'fields as' and 'values as' point back to an identical list; <NAME> marks a mode.

## Memory map
0xF0000000 REBOOT size 0xC
0xF0001000 TIMER0 size 0x18
0xF0002000 CRG size 0x20
0xF0003000 GPIO size 0x28
0xF0005000 UART size 0x20
0xF0007000 CONSOLE size 0x20
0xF0009000 APP_UART size 0x20
0xF000A000 INFO size 0x30
0xF000B000 SRAM_EXT size 0x8
0xF000C000 MEMLCD size 0x20
0xF000D000 COM size 0x1C
0xF000E000 I2C size 0x28
0xF000F000 BTEVENTS size 0xC
0xF0010000 MESSIBLE size 0xC
0xF0011000 MESSIBLE2 size 0xC
0xF0012000 TICKTIMER size 0x14
0xF0013000 SUSRES size 0x28
0xF0014000 POWER size 0x24
0xF0015000 SPINOR_SOFT_INT size 0x10
0xF0016000 SPINOR size 0x34
0xF0017000 KEYBOARD size 0x34
0xF0018000 KEYINJECT size 0x8
0xF0019000 SEED size 0x8
0xF001A000 KEYROM size 0x10
0xF001B000 AUDIO size 0x24
0xF001C000 TRNG_KERNEL size 0x1C
0xF001D000 TRNG_SERVER size 0xE8
0xF001E000 TRNG size 0x50
0xF001F000 SHA512 size 0x64
0xF0020000 ENGINE size 0x2C
0xF0021000 JTAG size 0x8
0xF0022000 WDT size 0xC
0xF0023000 USBDEV size 0x14
0xF0024000 D11CTIME size 0x8
0xF0025000 WFI size 0x8
0xF0026000 IDENTIFIER_MEM size 0x4

## Interrupts
0 timer0 (TIMER0)
1 gpio (GPIO)
2 uart (UART)
3 console (CONSOLE)
4 app_uart (APP_UART)
5 com (COM)
6 i2c (I2C)
7 btevents (BTEVENTS)
8 ticktimer (TICKTIMER)
9 susres (SUSRES)
10 power (POWER)
11 spinor_soft_int (SPINOR_SOFT_INT)
12 spinor (SPINOR)
13 keyboard (KEYBOARD)
14 audio (AUDIO)
15 trng_kernel (TRNG_KERNEL)
16 trng_server (TRNG_SERVER)
17 sha512 (SHA512)
18 engine (ENGINE)
19 usbdev (USBDEV)

## Further device data
memoryRegions:
  ROM baseAddress=0x80000000 size=0x00010000
  VEXRISCV_DEBUG baseAddress=0xEFFF0000 size=0x00000100
  SRAM_EXT baseAddress=0x40000000 size=0x01000000
  MEMLCD baseAddress=0xB0000000 size=0x00005C20
  SPIFLASH baseAddress=0x20000000 size=0x08000000
  AUDIO baseAddress=0xE0000000 size=0x00000004
  SHA512 baseAddress=0xE0002000 size=0x00000004
  ENGINE baseAddress=0xE0020000 size=0x00020000
  USBDEV baseAddress=0xE0040000 size=0x00010000
  CSR baseAddress=0xF0000000 size=0x00040000
constants:
  CONFIG_CLOCK_FREQUENCY value=100000000
  CONFIG_CPU_HAS_INTERRUPT value=None
  CONFIG_CPU_RESET_ADDR value=2147483648
  CONFIG_CPU_HAS_DCACHE value=None
  CONFIG_CPU_HAS_ICACHE value=None
  CONFIG_CPU_TYPE_VEXRISCV value=None
  CONFIG_CPU_VARIANT_STANDARD value=None
  CONFIG_CPU_HUMAN_NAME value=VexRiscv
  CONFIG_CPU_NOP value=nop
  CONFIG_BIOS_NO_BUILD_TIME value=None
  CONFIG_CSR_DATA_WIDTH value=32
  CONFIG_CSR_ALIGNMENT value=32
  CONFIG_BUS_STANDARD value=WISHBONE
  CONFIG_BUS_DATA_WIDTH value=32
  CONFIG_BUS_ADDRESS_WIDTH value=32
  CONFIG_BUS_BURSTING value=0
  APP_UART_INTERRUPT value=4
  AUDIO_INTERRUPT value=14
  BTEVENTS_INTERRUPT value=7
  COM_INTERRUPT value=5
  CONSOLE_INTERRUPT value=3
  ENGINE_INTERRUPT value=18
  GPIO_INTERRUPT value=1
  I2C_INTERRUPT value=6
  KEYBOARD_INTERRUPT value=13
  POWER_INTERRUPT value=10
  SHA512_INTERRUPT value=17
  SPINOR_INTERRUPT value=12
  SPINOR_SOFT_INT_INTERRUPT value=11
  SUSRES_INTERRUPT value=9
  TICKTIMER_INTERRUPT value=8
  TIMER0_INTERRUPT value=0
  TRNG_KERNEL_INTERRUPT value=15
  TRNG_SERVER_INTERRUPT value=16
  UART_INTERRUPT value=2
  USBDEV_INTERRUPT value=19

## REBOOT
Base 0xF0000000
0x00 SOC_RESET — Writing 0xAC to this register will do a full SoC reset, including CRGs and peripherals
  [7:0] soc_reset
0x04 ADDR reset 0x80000000 — The address written here will be used as the next reset vector
0x08 CPU_RESET — Writing anything to this register resets the CPU, and the CPU only; does not affect CRG or peripherals
  [0] cpu_reset

## TIMER0
Base 0xF0001000
0x00 LOAD — Load value when Timer is (re-)enabled. In One-Shot mode, the value written to this register specifies the Timer's duration in clock cycles.
0x04 RELOAD — Reload value when Timer reaches ``0``. In Periodic mode, the value written to this register specify the Timer's period in clock cycles.
0x08 EN — Enable flag of the Timer. Set this flag to ``1`` to enable/start the Timer. Set to ``0`` to disable the Timer.
  [0] en
0x0C EV_STATUS — This register contains the current raw level of the zero event trigger. Writes to this register have no effect.
  [0] zero — Level of the ``zero`` event
0x10 EV_PENDING — When a zero event occurs, the corresponding bit will be set in this register. To clear the Event, set the corresponding bit in this register.
  [0] zero — `1` if a `zero` event occurred. This Event is triggered on a **falling** edge.
0x14 EV_ENABLE — This register enables the corresponding zero events. Write a ``0`` to this register to disable individual events.
  [0] zero — Write a ``1`` to enable the ``zero`` Event
