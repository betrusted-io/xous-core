# bao1x_peri register map
Vendor: baochip
Registers are 32-bit, read-write, reset 0x0 unless marked. A register's access mark holds for its fields unless they carry their own. Offsets are from the block's base; [hi:lo] are bit positions; {n}, {i} and the like mark numbered series; <NAME> marks a mode.

## SCE_GLBSFR
Base 0x40028000
0x04 SFR_SUBEN — See `sce_glbsfra.sv#L76 <https://github.com/baochip/baochip-1x/blob/main/rtl/mod ules/crypto_top/rtl/sce_glbsfra.sv#L76>`__ (line numbers are approximate)
  [15:0] cr_suben — cr_suben read/write control register
0x08 SFR_APBS — See `sce_glbsfra.sv#L77 <https://github.com/baochip/baochip-1x/blob/main/rtl/mod ules/crypto_top/rtl/sce_glbsfra.sv#L77>`__ (line numbers are approximate)
  [4:0] cr_apbsopt — cr_apbsopt read/write control register
0x10 SFR_SRBUSY — See `sce_glbsfra.sv#L79 <https://github.com/baochip/baochip-1x/blob/main/rtl/mod ules/crypto_top/rtl/sce_glbsfra.sv#L79>`__ (line numbers are approximate)
  [15:0] sr_busy — sr_busy read only status register
0x14 SFR_FRDONE — See `sce_glbsfra.sv#L80 <https://github.com/baochip/baochip-1x/blob/main/rtl/mod ules/crypto_top/rtl/sce_glbsfra.sv#L80>`__ (line numbers are approximate)
  [15:0] fr_done — fr_done flag register. `1` means event happened, write back `1` in respective bit position to clear the flag
0x18 SFR_FRERR — See `sce_glbsfra.sv#L81 <https://github.com/baochip/baochip-1x/blob/main/rtl/mod ules/crypto_top/rtl/sce_glbsfra.sv#L81>`__ (line numbers are approximate)
  [15:0] fr_err — fr_err flag register. `1` means event happened, write back `1` in respective bit position to clear the flag
0x1C SFR_ARCLR — See `sce_glbsfra.sv#L84 <https://github.com/baochip/baochip-1x/blob/main/rtl/mod ules/crypto_top/rtl/sce_glbsfra.sv#L84>`__ (line numbers are approximate)
  [31:0] ar_clrram — ar_clrram performs action on write of value: 0xa5
0x20 SFR_TICKCYC — See `sce_glbsfra.sv#L116 <https://github.com/baochip/baochip-1x/blob/main/rtl/mo dules/crypto_top/rtl/sce_glbsfra.sv#L116>`__ (line numbers are approximate)
  [7:0] sfr_tickcyc — sfr_tickcyc read/write control register
0x24 SFR_TICKCNT — See `sce_glbsfra.sv#L117 <https://github.com/baochip/baochip-1x/blob/main/rtl/mo dules/crypto_top/rtl/sce_glbsfra.sv#L117>`__ (line numbers are approximate)
  [31:0] sfr_tickcnt — sfr_tickcnt read only status register
0x30 SFR_FFEN — See `sce_glbsfra.sv#L90 <https://github.com/baochip/baochip-1x/blob/main/rtl/mod ules/crypto_top/rtl/sce_glbsfra.sv#L90>`__ (line numbers are approximate)
  [5:0] cr_ffen — cr_ffen read/write control register
0x34 SFR_FFCLR — See `sce_glbsfra.sv#L96 <https://github.com/baochip/baochip-1x/blob/main/rtl/mod ules/crypto_top/rtl/sce_glbsfra.sv#L96>`__ (line numbers are approximate)
  [31:0] ar_ffclr — ar_ffclr performs action on write of value: (32'hff00+i)
{0x40+4i} SFR_FFCNT_SR_FF{i} (i=0..5) — See `sce_glbsfra.sv#L91 <https://github.com/baochip/baochip-1x/blob/main/rtl/mod ules/crypto_top/rtl/sce_glbsfra.sv#L91>`__ (line numbers are approximate)
  [15:0] sr_ff{i} — sr_ff read only status register
0x60 SFR_FRACERR — See `sce_glbsfra.sv#L86 <https://github.com/baochip/baochip-1x/blob/main/rtl/mod ules/crypto_top/rtl/sce_glbsfra.sv#L86>`__ (line numbers are approximate)
  [7:0] fr_acerr — fr_acerr flag register. `1` means event happened, write back `1` in respective bit position to clear the flag
{0xE0+4i} SFR_TS_SR_TS{i} (i=0..3) — See `sce_glbsfra.sv#L100 <https://github.com/baochip/baochip-1x/blob/main/rtl/mo dules/crypto_top/rtl/sce_glbsfra.sv#L100>`__ (line numbers are approximate)
  [31:0] sr_ts{i} — sr_ts read only status register

## DUART
Base 0x40042000
0x00 SFR_TXD — See `duart.sv#L42 <https://github.com/baochip/baochip-1x/blob/main/rtl/modules/c ore/rtl/duart.sv#L42>`__ (line numbers are approximate)
  [7:0] sfr_txd — sfr_txd read/write control register
0x04 SFR_CR — See `duart.sv#L43 <https://github.com/baochip/baochip-1x/blob/main/rtl/modules/c ore/rtl/duart.sv#L43>`__ (line numbers are approximate)
  [0] sfr_cr — sfr_cr read/write control register
0x08 SFR_SR — See `duart.sv#L44 <https://github.com/baochip/baochip-1x/blob/main/rtl/modules/c ore/rtl/duart.sv#L44>`__ (line numbers are approximate)
  [0] sfr_sr — sfr_sr read only status register
0x0C SFR_ETUC — See `duart.sv#L45 <https://github.com/baochip/baochip-1x/blob/main/rtl/modules/c ore/rtl/duart.sv#L45>`__ (line numbers are approximate)
  [15:0] sfr_etuc — sfr_etuc read/write control register
