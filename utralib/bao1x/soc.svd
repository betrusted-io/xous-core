# soc register map
Vendor: litex
Litex SoC 2025-07-23 01:19:07
Registers are 32-bit, read-write, reset 0x0 unless marked. A register's access mark holds for its fields unless they carry their own. Offsets are from the block's base; lines under a group give offsets from that group; [hi:lo] are bit positions; {n}, {i} and the like mark numbered series; 'fields as' and 'values as' point back to an identical list; <NAME> marks a mode.

## Memory map
0x40080000 IDENTIFIER_MEM size 0x4
0x40081000 MAIN size 0xC

## Further device data
memoryRegions:
  RERAM baseAddress=0x60000000 size=0x00400000
  SRAM baseAddress=0x61000000 size=0x00200000
  XIP baseAddress=0x70000000 size=0x08000000
  VEXRISCV_DEBUG baseAddress=0xEFFF0000 size=0x00001000
  CSR baseAddress=0x40080000 size=0x00040000
constants:
  CONFIG_CLOCK_FREQUENCY value=800000000
  CONFIG_CPU_TYPE_NONE value=None
  CONFIG_CPU_VARIANT_STANDARD value=None
  CONFIG_CPU_HUMAN_NAME value=Unknown
  CONFIG_BIOS_NO_BUILD_TIME value=None
  CONFIG_CSR_DATA_WIDTH value=32
  CONFIG_CSR_ALIGNMENT value=32
  CONFIG_BUS_STANDARD value=AXI-LITE
  CONFIG_BUS_DATA_WIDTH value=32
  CONFIG_BUS_ADDRESS_WIDTH value=32
  CONFIG_BUS_BURSTING value=0

## IDENTIFIER_MEM
Base 0x40080000
0x00 IDENTIFIER_MEM — 8 x 24-bit memory
  [7:0] identifier_mem

## MAIN
Base 0x40081000
0x00 DONE — Set to `1` if the simulation should auto-terminate
  [0] done
0x04 IRQTEST0
  [15:0] trigger — Triggers for interrupt testing bank 0
0x08 REPORT
  [31:0] report — Fast feedback for simulations
